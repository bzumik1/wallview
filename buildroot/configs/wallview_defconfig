## buildroot/configs/wallview_defconfig
```kconfig
BR2_aarch64=y
BR2_cortex_a35=y
BR2_JLEVEL=2
BR2_CCACHE=y
BR2_TOOLCHAIN_EXTERNAL=y
BR2_TOOLCHAIN_EXTERNAL_ARM_AARCH64=y
BR2_TARGET_GENERIC_HOSTNAME="wallview"
BR2_TARGET_GENERIC_ISSUE="WallView OS"
BR2_ROOTFS_DEVICE_CREATION_DYNAMIC_EUDEV=y
BR2_GLOBAL_PATCH_DIR="$(BR2_EXTERNAL_WALLVIEW_PATH)/patches"
BR2_ROOTFS_OVERLAY="$(BR2_EXTERNAL_WALLVIEW_PATH)/board/wallview/rootfs-overlay"
BR2_PACKAGE_BUSYBOX_CONFIG_FRAGMENT_FILES="$(BR2_EXTERNAL_WALLVIEW_PATH)/board/wallview/busybox.fragment"
BR2_PACKAGE_MESA3D=y
BR2_PACKAGE_MESA3D_LLVM=y
BR2_PACKAGE_MESA3D_GALLIUM_DRIVER_PANFROST=y
BR2_PACKAGE_MESA3D_OPENGL_EGL=y
BR2_PACKAGE_MESA3D_OPENGL_ES=y
BR2_PACKAGE_WPEWEBKIT=y
BR2_PACKAGE_LIBSOUP3_SSL=y
BR2_PACKAGE_COG=y
BR2_PACKAGE_COG_PROGRAMS_HOME_URI=""
# BR2_PACKAGE_COG_PLATFORM_FDO is not set
BR2_PACKAGE_COG_PLATFORM_DRM=y
BR2_PACKAGE_SHARED_MIME_INFO=y
BR2_PACKAGE_XKEYBOARD_CONFIG=y
BR2_PACKAGE_DEJAVU=y
BR2_PACKAGE_CA_CERTIFICATES=y
BR2_TARGET_ROOTFS_TAR=y
BR2_ROOTFS_POST_BUILD_SCRIPT="$(BR2_EXTERNAL_WALLVIEW_PATH)/board/wallview/post-build.sh"
BR2_TARGET_ROOTFS_EROFS=y
BR2_TARGET_ROOTFS_EROFS_LZ4HC=y
BR2_PACKAGE_WPA_SUPPLICANT=y
BR2_PACKAGE_WPA_SUPPLICANT_CLI=y
BR2_PACKAGE_WIRELESS_REGDB=y
BR2_PACKAGE_IW=y
BR2_PACKAGE_DROPBEAR=y
BR2_PACKAGE_E2FSPROGS=y
BR2_PACKAGE_ALSA_UTILS=y
BR2_PACKAGE_ALSA_UTILS_AMIXER=y
BR2_PACKAGE_ALSA_UTILS_APLAY=y
BR2_PACKAGE_KEXEC=y
BR2_TARGET_TZ_INFO=y
BR2_TARGET_LOCALTIME="Europe/Prague"
BR2_ENABLE_LOCALE_WHITELIST="C en_US cs_CZ"
BR2_GENERATE_LOCALE="en_US.UTF-8 cs_CZ.UTF-8"
BR2_PACKAGE_BLUEZ5_UTILS=y
BR2_PACKAGE_BLUEZ5_UTILS_CLIENT=y
```
